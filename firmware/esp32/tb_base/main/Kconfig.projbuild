## firmware/esp32/tb_base/main/Kconfig.projbuild
```kconfig
menu "Mini TurtleBot Base Config"

config TB_WIFI_SSID
    string "WiFi SSID"
    default "Kim-Elecom-2G"

config TB_WIFI_PASS
    string "WiFi Password"
    default "discovery"

config TB_TCP_PORT
    int "TCP Server Port"
    default 9000

config TB_ROBOT_ID
    string "Robot ID (shown on OLED)"
    default "tb_01"

menu "Pin Mapping"

config TB_I2C_SDA
    int "I2C SDA GPIO"
    default 8

config TB_I2C_SCL
    int "I2C SCL GPIO"
    default 9

config TB_MOTOR_PWM_L
    int "Left Motor PWM GPIO"
    default 4

config TB_MOTOR_DIR_L
    int "Left Motor DIR GPIO"
    default 5

config TB_MOTOR_PWM_R
    int "Right Motor PWM GPIO"
    default 6

config TB_MOTOR_DIR_R
    int "Right Motor DIR GPIO"
    default 7

endmenu

endmenu
```
